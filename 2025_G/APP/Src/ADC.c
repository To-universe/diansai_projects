#include "ADC.h"
#include "../../Core/Inc/adc.h"
#include "arm_math_types.h"
#include "dsp/basic_math_functions.h"
#include "dsp/fast_math_functions.h"
#include "dsp/statistics_functions.h"
#include "dsp/transform_functions.h"
#include "stm32g4xx_hal.h"
#include "stm32g4xx_hal_adc.h"
#include "stm32g4xx_hal_tim.h"
#include "tim.h"
#include <stdint.h>

uint16_t adc_buffer_1[FFT_SIZE];
q15_t fft_input[FFT_SIZE];
q15_t fft_output[FFT_SIZE*2];
uint32_t amp_response[AD9851_SWEEP_FREQ_COUNT];

volatile uint8_t adc_wait_flag=0;
volatile uint32_t stable_tick=0;
volatile uint32_t now_tick=0;
volatile uint8_t adc_ready=0;
volatile uint8_t adc_sampling=0;

arm_rfft_instance_q15 fft_instance;

void ADC_wait_stable(void){
    if(!adc_wait_flag && !adc_sampling){
        adc_wait_flag=1;
        stable_tick = HAL_GetTick();
    }
}

void ADC_sample_start(void){
    if(adc_sampling){
        return;
    }
    adc_sampling=1;
    HAL_TIM_Base_Stop(&htim2);
    __HAL_TIM_SET_COUNTER(&htim2,0);
    HAL_ADCEx_MultiModeStart_DMA(&hadc1, (uint32_t *)adc_buffer.u16, ADC_BUFFER_SIZE);
    HAL_TIM_Base_Start(&htim2);
}

void ADC_Legacy_ConvCpltCallback(ADC_HandleTypeDef *hadc){
    if(hadc->Instance == ADC1){
        HAL_TIM_Base_Stop(&htim2);
        HAL_ADC_Stop_DMA(&hadc1);
        adc_sampling=0;
        adc_ready=1;
    }
}

void adc_to_q15(void){
    uint32_t sum = 0;
    for(uint16_t i = 0;i<FFT_SIZE;i++){
        sum += adc_buffer_1[i];
    }
    int32_t mean = (int32_t)(sum/FFT_SIZE);
    for(uint16_t i = 0; i<FFT_SIZE;i++){
        int32_t centered = (int32_t)adc_buffer_1[i]-mean;
        int32_t q15_value = centered <<4;
        if(q15_value>32767){
            q15_value=32767;
        }else if(q15_value<-32768){
            q15_value = -32768;
        }
        fft_input[i]=q15_value;
    }
}

void fft_calc(void){
    adc_to_q15();
    q15_t mean;
    arm_mean_q15(fft_input,FFT_SIZE, &mean);
    arm_offset_q15(fft_input, -mean,fft_input,FFT_SIZE);
    arm_mult_q15(fft_input, hanning_window, fft_input, FFT_SIZE);
    arm_rfft_q15(&fft_instance, fft_input, fft_output);
}

uint32_t fft_amp_calc(uint16_t index){
    int32_t real = fft_output[2*index];
    int32_t image = fft_output[2*index+1];
    return real*real+image*image;
}

void response_calc(uint16_t index, uint32_t freq){
    uint16_t bin = (uint16_t)((((uint64_t)freq * FFT_SIZE) + (sample_rate / 2U)) / sample_rate);
    uint16_t max_valid_bin = (FFT_SIZE / 2U) - 1U;

    if(bin < 1U){
        bin = 1U;
    }else if(bin > max_valid_bin){
        bin = max_valid_bin;
    }

    uint16_t start = bin > 2U ? bin - 2U : 1U;
    uint16_t end = (bin + 2U) < max_valid_bin ? bin + 2U : max_valid_bin;

    uint32_t max_amp = fft_amp_calc(start);
    for(uint16_t i = start+1;i<=end;i++){
        uint32_t amp = fft_amp_calc(i);
        if(amp > max_amp){
            max_amp = amp;
        }
    }
    amp_response[index]=max_amp;
}


























const q15_t hanning_window[FFT_SIZE] = {
    0, 0, 0, 0, 0, 0, 0, 0, 0, 0, 0, 1,
    1, 1, 1, 1, 1, 1, 2, 2, 2, 2, 2, 3,
    3, 3, 3, 4, 4, 4, 4, 5, 5, 5, 6, 6,
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    0, 0, 0, 0, 0, 0, 0, 0
};

